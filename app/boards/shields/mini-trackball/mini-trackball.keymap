/*
 * Copyright (c) 2020 The ZMK Contributors
 *
 * SPDX-License-Identifier: MIT
 */

#include <behaviors.dtsi>
#include <dt-bindings/zmk/keys.h>
#include <dt-bindings/zmk/bt.h>
#include <dt-bindings/zmk/outputs.h>
#include <dt-bindings/zmk/mouse.h>

#define DEFAULT 0

/ { 
    keymap {
        compatible = "zmk,keymap";
                
     		default_layer {
            label = "CLMK";
        		bindings = <
            		&kp Q     &kp W             &kp F             &kp P           
             		>;
                trackball-bindings = <&tmv>;
		    };
   	};
};