/*
 * Copyright (c) 2020 The ZMK Contributors
 *
 * SPDX-License-Identifier: MIT
 */

#include "sensor_bed_tb.dtsi"

/*  adjust matrix transform for pepripheral split */
&default_transform {
	col-offset = <1>;
};

/* Enable spi2 bus and the trackball, and define their pins */
&spi2 {
  status = "okay";
  sck-pin = <24>;
  mosi-pin = <9>;
  miso-pin = <9>; // same as mosi (3-wire spi)
  cs-gpios = <&gpio0 29 GPIO_ACTIVE_LOW>;
};

&trackball {
  status = "okay";
  irq-gpios = <&gpio0 2 (GPIO_ACTIVE_LOW | GPIO_PULL_UP)>;
};