/*
 * Copyright (c) 2020 The ZMK Contributors
 *
 * SPDX-License-Identifier: MIT
 */

#include "corne-pro.dtsi"

// adjust matrix transform for pepripheral split
&default_transform {
	col-offset = <6>;
};

// setup kscan pins
&kscan {
  row-gpios
	  = <&pro_micro 19  (GPIO_ACTIVE_HIGH | GPIO_PULL_DOWN)>
		, <&pro_micro 18  (GPIO_ACTIVE_HIGH | GPIO_PULL_DOWN)>
		, <&pro_micro 15 (GPIO_ACTIVE_HIGH | GPIO_PULL_DOWN)>
		, <&pro_micro 10 (GPIO_ACTIVE_HIGH | GPIO_PULL_DOWN)>
		;

	col-gpios
		= <&pro_micro  9 GPIO_ACTIVE_HIGH>
		, <&pro_micro  8 GPIO_ACTIVE_HIGH>
		, <&pro_micro 16 GPIO_ACTIVE_HIGH>
		, <&pro_micro 14 GPIO_ACTIVE_HIGH>
		, <&pro_micro 20 GPIO_ACTIVE_HIGH>
		, <&pro_micro 21 GPIO_ACTIVE_HIGH>
		;
};