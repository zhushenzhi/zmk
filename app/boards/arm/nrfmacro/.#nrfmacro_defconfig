## app/boards/shields/charybdis/Kconfig.shield
```kconfig
# Copyright (c) 2020 Pete Johanson
# SPDX-License-Identifier: MIT

config SHIELD_charybdis_LEFT
    def_bool $(shields_list_contains,charybdis_left)

config SHIELD_charybdis_RIGHT
    def_bool $(shields_list_contains,charybdis_right)
```

## app/boards/shields/mini-trackball/Kconfig.defconfig
```kconfig
# Copyright (c) 2020 The ZMK Contributors
# SPDX-License-Identifier: MIT

if MINI_TRACKBALL

config ZMK_KEYBOARD_NAME
	default "Mini-Trackball"

endif
```

## app/boards/shields/mini-trackball/Kconfig.shield
```kconfig
# Copyright (c) 2020 The ZMK Contributors
# SPDX-License-Identifier: MIT

config MINI_TRACKBALL
	def_bool $(shields_list_contains,mini-trackball)
```

## app/boards/shields/sensor_bed/Kconfig.defconfig
```kconfig
# Copyright (c) 2020 The ZMK Contributors
# SPDX-License-Identifier: MIT

if SENSOR_BED_RIGHT

config ZMK_KEYBOARD_NAME
	default "SensorBed"

config ZMK_SPLIT_BLE_ROLE_CENTRAL
	default y

endif

if SENSOR_BED_LEFT
config ZMK_KEYBOARD_NAME
  default "SensorBed-slave"

endif

if SENSOR_BED_LEFT || SENSOR_BED_RIGHT

config ZMK_SPLIT
	default y

config ZMK_USB
	default y

endif
```

## app/boards/shields/sensor_bed/Kconfig.shield
```kconfig
# Copyright (c) 2020 The ZMK Contributors
# SPDX-License-Identifier: MIT

config SENSOR_BED_LEFT
	def_bool $(shields_list_contains,sensor_bed_left)

config SENSOR_BED_RIGHT
	def_bool $(shields_list_contains,sensor_bed_right)
```

## app/boards/shields/sensor_bed_tb/Kconfig.defconfig
```kconfig
# Copyright (c) 2020 The ZMK Contributors
# SPDX-License-Identifier: MIT

if SENSOR_BED_TB_RIGHT

config ZMK_KEYBOARD_NAME
	default "SensorBed-TB"

config ZMK_SPLIT_BLE_ROLE_CENTRAL
	default y

endif

if SENSOR_BED_TB_LEFT
config ZMK_KEYBOARD_NAME
  default "SensorBed-TB-slave"

endif

if SENSOR_BED_TB_LEFT || SENSOR_BED_TB_RIGHT

config ZMK_SPLIT
	default y

config ZMK_USB
	default y

endif
```

## app/boards/shields/sensor_bed_tb/Kconfig.shield
```kconfig
# Copyright (c) 2020 The ZMK Contributors
# SPDX-License-Identifier: MIT

config SENSOR_BED_TB_LEFT
	def_bool $(shields_list_contains,sensor_bed_tb_left)

config SENSOR_BED_TB_RIGHT
	def_bool $(shields_list_contains,sensor_bed_tb_right)
```

## app/dts/bindings/behaviors/zmk,behavior-calib.yaml
```yaml
# Copyright (c) 2020 The ZMK Contributors
# SPDX-License-Identifier: MIT

description: Force re-calibration of the capasitive sensors

compatible: "zmk,behavior-calib"

include: zero_param.yaml
```
